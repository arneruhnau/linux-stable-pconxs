## Documentation/devicetree/bindings/video/ssd1307fb.txt
```
* Solomon SSD1307 Framebuffer Driver

Required properties:
  - compatible: Should be "solomon,<chip>fb-<bus>". The only supported bus for
    now is i2c, and the supported chips are ssd1305, ssd1306 and ssd1307.
  - reg: Should contain address of the controller on the I2C bus. Most likely
         0x3c or 0x3d
  - pwm: Should contain the pwm to use according to the OF device tree PWM
         specification [0]. Only required for the ssd1307.
  - reset-gpios: Should contain the GPIO used to reset the OLED display
  - solomon,height: Height in pixel of the screen driven by the controller
  - solomon,width: Width in pixel of the screen driven by the controller

Optional properties:
  - reset-active-low: Is the reset gpio is active on physical low?
  - solomon,page-offset: Offset of pages (band of 8 pixels) that the screen is
    mapped to. Defaults to 1.
  - solomon,column-offset: Offset of columns that the screen is mapped to.
    Defaults to 0.
  - solomon,display-offset defaults to 0x20
  - solomon,com-pins-configuration defaults to 0x22
  - solomon,contrast defaults to 0x7F
  - solomon,segment-remap: If present configures segment remapping

For details on the solomon, - properties consult the chip manual.
Values applicable to your display should be stated by the display's
manufacturer.

[0]: Documentation/devicetree/bindings/pwm/pwm.txt

Examples:
ssd1307: oled@3c {
        compatible = "solomon,ssd1307fb-i2c";
        reg = <0x3c>;
        pwms = <&pwm 4 3000>;
        reset-gpios = <&gpio2 7>;
        reset-active-low;
};
```

## drivers/target-systemelektronik/Kconfig
```kconfig
menuconfig TARGET_SYSTEMELEKTRONIK
	bool "Target Systemelektronik Drivers"
	default y

if TARGET_SYSTEMELEKTRONIK

config TARGET_SYSTEMELEKTRONIK_FPGA
	tristate "Target Systemelektronik FPGA"
	depends on DMA_CMA
	default m
	help
	Say Y or M here to enable the Target Systemelektronik FPGA device driver

endif
```
